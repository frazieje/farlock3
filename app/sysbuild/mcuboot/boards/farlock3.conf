## boards/frazieje/farlock3/Kconfig.defconfig
```kconfig
# FARLock v3 board configuration
#
# SPDX-License-Identifier: Apache-2.0

if BOARD_FARLOCK3

config HW_STACK_PROTECTION
	default ARCH_HAS_STACK_PROTECTION

if NORDIC_QSPI_NOR

config NORDIC_QSPI_NOR_FLASH_LAYOUT_PAGE_SIZE
	default 4096 if MCUBOOT || BOOTLOADER_MCUBOOT

endif # NORDIC_QSPI_NOR

endif # BOARD_FARLOCK3
```

## boards/frazieje/farlock3/board.yml
```yaml
board:
  name: farlock3
  full_name: FARLock v3
  vendor: frazieje
  socs:
  - name: nrf52840
```

## dts/bindings/input/frazieje,lock-switches.yaml
```yaml
# SPDX-License-Identifier: Apache-2.0

description: |
  Mechanical switches of the FARLock bolt mechanism.

  The position switch is a limit switch that is active in one end position
  of the bolt and inactive in the other. The direction switch tells the
  firmware which way the motor must turn to lock the door (left or right
  handed installation).

  Which end position means "locked" depends on the direction switch:
  locked = position_active == direction_active.

compatible: "frazieje,lock-switches"

include: base.yaml

properties:
  position-gpios:
    type: phandle-array
    required: true
    description: Bolt position (limit) switch input.

  direction-gpios:
    type: phandle-array
    required: true
    description: Handedness switch input. Active selects the "right" direction.
```

## dts/bindings/motor/frazieje,tb6612-motor.yaml
```yaml
# SPDX-License-Identifier: Apache-2.0

description: |
  One channel of a Toshiba TB6612FNG dual h-bridge used as a brushed DC
  motor driver. Speed is set with the PWM input, direction with IN1/IN2 and
  the whole driver is put to sleep by pulling STBY low.

  Example:

    motor: motor {
        compatible = "frazieje,tb6612-motor";
        pwms = <&pwm0 0 PWM_MSEC(20) PWM_POLARITY_NORMAL>;
        in1-gpios = <&gpio0 29 GPIO_ACTIVE_HIGH>;
        in2-gpios = <&gpio0 30 GPIO_ACTIVE_HIGH>;
        stby-gpios = <&gpio0 31 GPIO_ACTIVE_HIGH>;
    };

compatible: "frazieje,tb6612-motor"

include: base.yaml

properties:
  pwms:
    type: phandle-array
    required: true
    description: PWM output connected to the PWMA (or PWMB) input.

  in1-gpios:
    type: phandle-array
    required: true
    description: GPIO connected to AIN1 (or BIN1).

  in2-gpios:
    type: phandle-array
    required: true
    description: GPIO connected to AIN2 (or BIN2).

  stby-gpios:
    type: phandle-array
    required: true
    description: GPIO connected to STBY. Active means the driver is enabled.
```

## west.yml
```yaml
manifest:
  version: "1.0"

  remotes:
    - name: ncs
      url-base: https://github.com/nrfconnect

  projects:
    - name: sdk-nrf
      remote: ncs
      revision: v3.3.0
      import: true
      path: nrf

  self:
    path: farlock3
```
